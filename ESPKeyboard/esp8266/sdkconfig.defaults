## ESPKeyboard/esp8266/sdkconfig.defaults
```kconfig
CONFIG_ESP8266_DEFAULT_CPU_FREQ_80=y
CONFIG_ESP8266_DEFAULT_CPU_FREQ_MHZ=80
CONFIG_ESPNOW_CHANNEL=1
CONFIG_ESPNOW_PEER_MAC="00:00:00:00:00:00"
```

## esp32-s3/main/Kconfig.projbuild
```kconfig
menu "ESPKeyboard ESP-NOW link"

config ESPNOW_CHANNEL
    int "ESP-NOW channel"
    range 1 13
    default 1

config ESPNOW_PEER_MAC
    string "Paired ESP8266 station MAC address"
    default "00:00:00:00:00:00"
    help
        Set this to the station MAC printed by the ESP8266 receiver.
        ESP-NOW stays disabled while this is the all-zero default, so the
        transmitter sends nothing until it is paired.

config ESPKEYBOARD_TEST_TYPER
    bool "Send a test keystroke periodically"
    default n
    help
        Bring-up aid. Sends the letter "a" over ESP-NOW at a fixed interval so
        the radio link and the receiver's USB keyboard can be tested without
        attaching a USB keyboard to this board.

        It stays quiet while a real keyboard is connected, so leaving it on
        does not corrupt real typing. Even so, turn it off for normal use: it
        injects keystrokes into whatever host the receiver is plugged into.

config ESPKEYBOARD_TEST_TYPER_INTERVAL_MS
    int "Test keystroke interval (ms)"
    depends on ESPKEYBOARD_TEST_TYPER
    range 200 60000
    default 2000

endmenu
```

## esp8266/main/Kconfig.projbuild
```kconfig
menu "ESPKeyboard ESP-NOW link"

config ESPNOW_CHANNEL
    int "ESP-NOW channel"
    range 1 13
    default 1

config ESPNOW_PEER_MAC
    string "Paired ESP32-S3 station MAC address"
    default "00:00:00:00:00:00"
    help
        Set this to the station MAC printed by the ESP32-S3 transmitter.

endmenu
```
